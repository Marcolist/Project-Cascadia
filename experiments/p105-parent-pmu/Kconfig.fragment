## experiments/p105-parent-pmu/Kconfig.fragment
```kconfig
config APPLE_PMU_D1946_BANK0_EXPERIMENT
	bool "Experimental P105 global D1946 bank0 parent transport"
	depends on MFD_APPLE_PMU_I2C=y
	default n
	help
	  Source-only unvalidated option. Also requires explicit readonly opt-in
	  parameter; no charger activation, firmware replay or analog safety grant.
```
